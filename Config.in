## Config.in
```kconfig
menu "OOB Comm packages"
	source "$BR2_EXTERNAL_pinephone_PATH/package/dpinger/Config.in"
	source "$BR2_EXTERNAL_pinephone_PATH/package/libnitrokey/Config.in"
	source "$BR2_EXTERNAL_pinephone_PATH/package/nkmacsec/Config.in"
	source "$BR2_EXTERNAL_pinephone_PATH/package/udptunnel/Config.in"
	source "$BR2_EXTERNAL_pinephone_PATH/package/audioreceiver/Config.in"
	source "$BR2_EXTERNAL_pinephone_PATH/package/audiostreamer/Config.in"
	source "$BR2_EXTERNAL_pinephone_PATH/package/telemetrymsg/Config.in"
	source "$BR2_EXTERNAL_pinephone_PATH/package/userinterface/Config.in"
	source "$BR2_EXTERNAL_pinephone_PATH/package/oobuivertical/Config.in"
	source "$BR2_EXTERNAL_pinephone_PATH/package/pptk/Config.in"
	source "$BR2_EXTERNAL_pinephone_PATH/package/udpproxy/Config.in"
	source "$BR2_EXTERNAL_pinephone_PATH/package/udp2raw/Config.in"
	source "$BR2_EXTERNAL_pinephone_PATH/package/rtptun/Config.in"
endmenu
```

## configs/pinephone_defconfig
```kconfig
BR2_aarch64=y
BR2_ARM_FPU_VFPV4=y
BR2_GCC_VERSION_10_X=y
BR2_TOOLCHAIN_BUILDROOT_CXX=y
BR2_TARGET_GENERIC_HOSTNAME="pinephone"
BR2_TARGET_GENERIC_ISSUE="Welcome to PINE64"
BR2_INIT_SYSTEMD=y
BR2_TARGET_GENERIC_ROOT_PASSWD="root"
BR2_SYSTEM_DEFAULT_PATH="/bin:/sbin:/usr/bin:/usr/sbin"
BR2_ROOTFS_OVERLAY="${BR2_EXTERNAL}/board/pinephone/pine"
BR2_ROOTFS_POST_IMAGE_SCRIPT="support/scripts/genimage.sh"
BR2_ROOTFS_POST_SCRIPT_ARGS="-c ${BR2_EXTERNAL}/board/pinephone/genimage.cfg"
BR2_LINUX_KERNEL=y
BR2_LINUX_KERNEL_CUSTOM_GIT=y
BR2_LINUX_KERNEL_CUSTOM_REPO_URL="https://github.com/megous/linux.git"
BR2_LINUX_KERNEL_CUSTOM_REPO_VERSION="orange-pi-6.1-20230214-2103"
BR2_LINUX_KERNEL_USE_CUSTOM_CONFIG=y
BR2_LINUX_KERNEL_CUSTOM_CONFIG_FILE="${BR2_EXTERNAL}/profiles/kernel/megikernel_kbd.conf"
BR2_LINUX_KERNEL_DTS_SUPPORT=y
BR2_LINUX_KERNEL_INTREE_DTS_NAME="allwinner/sun50i-a64-pinephone-1.2"
BR2_LINUX_KERNEL_NEEDS_HOST_OPENSSL=y
BR2_PACKAGE_LINUX_TOOLS_CPUPOWER=y
BR2_PACKAGE_ALSA_UTILS=y
BR2_PACKAGE_ALSA_UTILS_AMIXER=y
BR2_PACKAGE_ALSA_UTILS_APLAY=y
BR2_PACKAGE_GST1_PLUGINS_BASE_PLUGIN_AUDIORATE=y
BR2_PACKAGE_GST1_PLUGINS_BASE_PLUGIN_ALSA=y
BR2_PACKAGE_GST1_PLUGINS_BASE_PLUGIN_OGG=y
BR2_PACKAGE_GST1_PLUGINS_BASE_PLUGIN_OPUS=y
BR2_PACKAGE_GST1_PLUGINS_BASE_PLUGIN_VORBIS=y
BR2_PACKAGE_GST1_PLUGINS_GOOD=y
BR2_PACKAGE_GST1_PLUGINS_GOOD_JPEG=y
BR2_PACKAGE_GST1_PLUGINS_GOOD_PNG=y
BR2_PACKAGE_GST1_PLUGINS_GOOD_PLUGIN_AUDIOPARSERS=y
BR2_PACKAGE_GST1_PLUGINS_GOOD_PLUGIN_RTP=y
BR2_PACKAGE_GST1_PLUGINS_GOOD_PLUGIN_RTSP=y
BR2_PACKAGE_GST1_PLUGINS_GOOD_PLUGIN_UDP=y
BR2_PACKAGE_GST1_PLUGINS_GOOD_PLUGIN_V4L2=y
BR2_PACKAGE_GST1_PLUGINS_BAD=y
BR2_PACKAGE_GST1_PLUGINS_BAD_PLUGIN_MPEGDEMUX=y
BR2_PACKAGE_GST1_PLUGINS_BAD_PLUGIN_MPEGTSDEMUX=y
BR2_PACKAGE_GST1_PLUGINS_BAD_PLUGIN_MPEGTSMUX=y
BR2_PACKAGE_GST1_PLUGINS_BAD_PLUGIN_MPEGPSMUX=y
BR2_PACKAGE_GST1_PLUGINS_BAD_PLUGIN_VIDEOPARSERS=y
BR2_PACKAGE_GST1_PLUGINS_BAD_PLUGIN_OPENH264=y
BR2_PACKAGE_GST1_LIBAV=y
BR2_PACKAGE_MINIMODEM=y
BR2_PACKAGE_GDB=y
BR2_PACKAGE_GDB_SERVER=y
BR2_PACKAGE_GDB_DEBUGGER=y
BR2_PACKAGE_VALGRIND=y
BR2_PACKAGE_E2FSPROGS=y
BR2_PACKAGE_E2FSPROGS_RESIZE2FS=y
BR2_PACKAGE_DEJAVU=y
BR2_PACKAGE_MESA3D=y
BR2_PACKAGE_MESA3D_GALLIUM_DRIVER_LIMA=y
BR2_PACKAGE_MESA3D_OPENGL_EGL=y
BR2_PACKAGE_MESA3D_OPENGL_ES=y
BR2_PACKAGE_QT5=y
BR2_PACKAGE_QT5BASE_LINUXFB=y
BR2_PACKAGE_QT5BASE_EGLFS=y
BR2_PACKAGE_QT5BASE_DEFAULT_QPA="eglfs"
BR2_PACKAGE_QT5BASE_FONTCONFIG=y
BR2_PACKAGE_QT5BASE_HARFBUZZ=y
BR2_PACKAGE_QT5BASE_GIF=y
BR2_PACKAGE_QT5BASE_JPEG=y
BR2_PACKAGE_QT5BASE_PNG=y
BR2_PACKAGE_QT5BASE_DBUS=y
BR2_PACKAGE_QT5BASE_ICU=y
BR2_PACKAGE_QT5IMAGEFORMATS=y
BR2_PACKAGE_QT5MULTIMEDIA=y
BR2_PACKAGE_QT5QUICKCONTROLS=y
BR2_PACKAGE_QT5QUICKCONTROLS2=y
BR2_PACKAGE_QT5VIRTUALKEYBOARD=y
BR2_PACKAGE_QT5VIRTUALKEYBOARD_LANGUAGE_LAYOUTS="all"
BR2_PACKAGE_QT5XMLPATTERNS=y
BR2_PACKAGE_XKEYBOARD_CONFIG=y
BR2_PACKAGE_LINUX_FIRMWARE=y
BR2_PACKAGE_LINUX_FIRMWARE_RTL_87XX=y
BR2_PACKAGE_CRYPTSETUP=y
BR2_PACKAGE_LIBSNDFILE=y
BR2_PACKAGE_MINIZIP=y
BR2_PACKAGE_SNAPPY=y
BR2_PACKAGE_LIBNSS=y
BR2_PACKAGE_CAIRO_PNG=y
BR2_PACKAGE_LCMS2=y
BR2_PACKAGE_PANGO=y
BR2_PACKAGE_WAYLAND=y
BR2_PACKAGE_WEBP=y
BR2_PACKAGE_WEBP_DEMUX=y
BR2_PACKAGE_WEBP_MUX=y
BR2_PACKAGE_LIBINPUT=y
BR2_PACKAGE_LIBV4L=y
BR2_PACKAGE_LIBV4L_UTILS=y
BR2_PACKAGE_LIBXKBCOMMON=y
BR2_PACKAGE_LIBXSLT=y
BR2_PACKAGE_LIBVPX=y
BR2_PACKAGE_LIBCURL_TLS_NONE=y
BR2_PACKAGE_LIBEVENT=y
BR2_PACKAGE_RE2=y
BR2_PACKAGE_READLINE=y
BR2_PACKAGE_ETHTOOL=y
BR2_PACKAGE_GLORYTUN=y
BR2_PACKAGE_IGMPPROXY=y
BR2_PACKAGE_IPERF3=y
BR2_PACKAGE_IPROUTE2=y
BR2_PACKAGE_IPTABLES=y
BR2_PACKAGE_IW=y
BR2_PACKAGE_IWD=y
BR2_PACKAGE_MACCHANGER=y
BR2_PACKAGE_MODEM_MANAGER=y
BR2_PACKAGE_MODEM_MANAGER_LIBMBIM=y
BR2_PACKAGE_MODEM_MANAGER_LIBQMI=y
BR2_PACKAGE_NFTABLES=y
BR2_PACKAGE_OPENSSH=y
BR2_PACKAGE_RSYNC=y
BR2_PACKAGE_SMCROUTE=y
BR2_PACKAGE_TCPDUMP=y
BR2_PACKAGE_UDPCAST=y
BR2_PACKAGE_UDPCAST_SENDER=y
BR2_PACKAGE_UDPCAST_RECEIVER=y
BR2_PACKAGE_WIREGUARD_TOOLS=y
BR2_PACKAGE_SCREEN=y
BR2_PACKAGE_HTOP=y
BR2_PACKAGE_NANO=y
BR2_TARGET_ROOTFS_EXT2=y
BR2_TARGET_ROOTFS_EXT2_4=y
BR2_TARGET_ROOTFS_EXT2_SIZE="500M"
BR2_TARGET_ARM_TRUSTED_FIRMWARE=y
BR2_TARGET_ARM_TRUSTED_FIRMWARE_PLATFORM="sun50i_a64"
BR2_TARGET_UBOOT=y
BR2_TARGET_UBOOT_BUILD_SYSTEM_KCONFIG=y
BR2_TARGET_UBOOT_CUSTOM_GIT=y
BR2_TARGET_UBOOT_CUSTOM_REPO_URL=" https://gitlab.com/pine64-org/u-boot.git"
BR2_TARGET_UBOOT_CUSTOM_REPO_VERSION="7206996ef7f89375dd74b275ced62d85f8bc7f42"
BR2_TARGET_UBOOT_BOARD_DEFCONFIG="pinephone"
BR2_TARGET_UBOOT_NEEDS_DTC=y
BR2_TARGET_UBOOT_NEEDS_PYLIBFDT=y
BR2_TARGET_UBOOT_NEEDS_ATF_BL31=y
# BR2_TARGET_UBOOT_FORMAT_BIN is not set
BR2_TARGET_UBOOT_FORMAT_ITB=y
BR2_TARGET_UBOOT_SPL=y
BR2_TARGET_UBOOT_SPL_NAME="spl/sunxi-spl.bin"
BR2_TARGET_UBOOT_CUSTOM_MAKEOPTS="SCP=$(BINARIES_DIR)/../../board/pinephone/scp.bin"
BR2_PACKAGE_HOST_DOSFSTOOLS=y
BR2_PACKAGE_HOST_GENIMAGE=y
BR2_PACKAGE_HOST_MTOOLS=y
BR2_PACKAGE_HOST_NODEJS=y
BR2_PACKAGE_HOST_UBOOT_TOOLS=y
BR2_PACKAGE_HOST_UBOOT_TOOLS_FIT_SUPPORT=y
BR2_PACKAGE_HOST_UBOOT_TOOLS_BOOT_SCRIPT=y
BR2_PACKAGE_HOST_UBOOT_TOOLS_BOOT_SCRIPT_SOURCE="${BR2_EXTERNAL}/board/pinephone/boot.cmd"
BR2_PACKAGE_DPINGER=y
BR2_PACKAGE_NKMACSEC=y
BR2_PACKAGE_UDPTUNNEL=y
BR2_PACKAGE_AUDIORECEIVER=y
BR2_PACKAGE_AUDIOSTREAMER=y
BR2_PACKAGE_TELEMETRYMSG=y
BR2_PACKAGE_USERINTERFACE=y
BR2_PACKAGE_OOBUIVERTICAL=y
BR2_PACKAGE_PPTK=y
BR2_PACKAGE_UDPPROXY=y
```

## package/oobuivertical/Config.in
```kconfig
config BR2_PACKAGE_OOBUIVERTICAL
	bool "oobuivertical"
	depends on BR2_PACKAGE_QT5
	help
	  User interface for pinephone with keyboard
```

## package/telemetrymsg/Config.in
```kconfig
config BR2_PACKAGE_TELEMETRYMSG
        bool "telemetrymsg"
        select BR2_PACKAGE_LIBCURL
        help 
              FIFO to TCP socket msg
```

## package/userinterface/Config.in
```kconfig
config BR2_PACKAGE_USERINTERFACE
	bool "userinterface"
	depends on BR2_PACKAGE_QT5
	help
	  User interface for reTerminal
```
